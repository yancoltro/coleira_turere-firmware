## components/http/Kconfig.projbuild
```kconfig
menu "HTTPS Configuration"
    config ESP_HTTP_CLIENT_ENABLE_BASIC_AUTH
        bool "Basic Auth"
        default y
        help
            Enable requests using basic auth
            
endmenu
```

## components/https/Kconfig.projbuild
```kconfig
menu "HTTPS Configuration"
    config WEB_SERVER
        string "Web Server Address"
        default "127.0.0.1"
        help
            Main address of the data sending server.

    config WEB_PORT
        string "Web Port"
        default "5000"
        help
            Port used for communication with server

    config WEB_URL
        string "Web URL Resource"
        default "127.0.0.1:5000/resource"
        help
            
endmenu
```
